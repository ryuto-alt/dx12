// 更新内容のデータ（唯一の正）。ReleaseNotes.cpp の BuildAll() の中へ #include される。
//   新しい版が先頭。文言は標準語・簡潔に（画面にそのまま出る）。
//   highlights は 1〜4 件（カードで大きく見せる）。area は ReleaseNotes.cpp の kAreas の ID。
//   書式: Release{ 版, 日付, 見出し, { {題, 本文, 補足, 分野} ... }, { {種類, 題, 本文} ... } }
//   本文は 1〜2 行（カード向け）。数値や移行手順などの補足は detail に書く（GitHub 本文とツールチップに出る）。

v.push_back(Release{
    "2.3.0", "2026-10-04",
    "Arduino / ESP32 をつないで、本物のボタンやセンサーで遊べるようになりました",
    {
        { "Arduino / ESP32 をつなげます",
          "USB でつないだボードのボタン・ダイヤル・センサーを Lua の hw.* で読み、LED や振動を出力できます。配布ゲームでも動きます。",
          "設定は assets/hardware.json。挿し直しても自動で再接続し、ボードの名前で見分けます（COM 番号は見ません）。"
          "ハードのボタンを actions に割り当てれば、キーボードと同じアクションで遊べます。"
          "付属のファーム（hardware/firmware の UnoLink）は、エンジンが止まると 1 秒で出力を切ります。詳しくは docs/HARDWARE.md。",
          "general" },
        { "保存が途中で壊れなくなりました",
          "保存は一時ファイルに書いて確かめてから置き換えます。以前の版にも戻せます（ファイルメニュー「以前の版に戻す」）。",
          "保存中に 250 回強制終了しても壊れた版は 0 回でした。保存時間は 3.5〜9% 増えます。"
          "世代は .dx12/backups に残り、変わっていないファイルは共有します。壊れたシーンや空のシーンは開かず、自動保存も止めます。",
          "editor" },
        { "AI がハードとエンジンをまとめて扱えます",
          "MCP に hw_* を追加しました。ボードの一覧・値の読み取り・出力・校正・ファームの書き込みまで AI から行えます。",
          "書き込み（hw_flash）と危険な出力（hw_write_dangerous）は人の承認が要ります。実機なしで試すときは hw_simulate で仮想のボードを作れます。",
          "mcp" },
        { "AI 連携を複数同時につなげます",
          "エンジンに最大 8 本の AI クライアントが同時につながります。これまでは 2 本目が応答せずに固まっていました。",
          "Lua で仕掛けて数フレーム進めて読む作業が 1 回の呼び出しで済みます（lua_step）。"
          "正解の画像や性能予算を封印して、AI が採点側を書き換えたら品質ゲートで止まる仕組み（oracle）も入りました。",
          "mcp" },
    },
    {
        { K::Improvement, "大きなシーンでの AI 操作", "10 万体のシーンで、インスタンス群の展開が 16.2 秒 → 2.4 秒、診断が 2.0 秒 → 0.05 秒になりました" },
        { K::Improvement, "AI への応答を小さく", "ツールの結果を整形せずに返し、文字数を約 4 割減らしました" },
        { K::Fix, "ヒエラルキーの目・鍵ボタンで固まることがある", "" },
        { K::Fix, "フォルダの削除が消してはいけない場所に及ぶおそれ", "ドライブのルートやホームなどは、どこから来たパスでも消さないようにしました" },
    },
});

v.push_back(Release{
    "2.2.0", "2026-10-02",
    "10 万個の配置が軽く描け、大きなシーンを分けて保存できるようになりました",
    {
        { "大量の配置を GPU で描きます",
          "1024 個以上のインスタンス群は、描く物の選別を GPU が行います。10 万個で 42fps → 640fps。",
          "対象は不透明の群だけです（半透明・アルファテストの群と小さい群は従来どおり）。"
          "複数の部品でできたモデルの群は、従来と薄い面の縁がわずかに違うことがあります。"
          "settings.json の instance_gpu_threshold（0 で無効）で切り替えられます。",
          "perf" },
        { "シーンを分けて保存できます",
          "ライティング窓の「シーンファイル」で「分割して保存」をオンにすると、場所ごと（既定 64m 四方）のファイルに分かれます。",
          "変わった場所のファイルだけを書き直すので、1 体動かして保存しても書き換わるのは 1 ファイルです。"
          "★分割したシーンは 2.1 以前のエンジンでは一部しか開けません。",
          "perf" },
        { "ビルド中もエディタを操作できます",
          "ゲームのビルドを裏で進め、進捗とキャンセルを表示します。",
          "MCP は build_game がすぐ応答し、get_build_status / cancel_build で状態を見られます。"
          "ビルドは開始時点で保存済みの内容を使います（ビルド中の保存はビルドに入りません）。",
          "editor" },
        { "HDR の空と日本語フォント",
          ".hdr / .exr の空の画像がそのまま使え、環境光も作られます。配布ゲームには日本語フォントが入ります。",
          "日本語フォントは Noto Sans JP（SIL Open Font License 1.1）。プロジェクトにフォントが無いとき自動で入り、ライセンス文も同梱されます。",
          "render" },
    },
    {
        { K::Improvement, "大きなシーンの保存と Play", "保存と Play のときの配置検査が速くなりました（10 万体で約 5 分 → 0.3 秒）" },
        { K::Improvement, "分割したシーンの読み込み", "場所ごとのファイルを並列に読みます" },
        { K::Fix, "動く床と止まった床の境目でキャラが半分の速さで運ばれる", "" },
    },
});

v.push_back(Release{
    "2.1.0", "2026-10-02",
    "大きなシーンが軽くなり、物理と配布ゲームの不具合をまとめて直しました",
    {
        { "大きなシーンが軽くなりました",
          "シーンファイルは約 1/3、読み込みは約 10 倍速く。同じモデルの大量配置は「インスタンス群」に 1 つへまとめられます。",
          "1.5 万体のシーンで 15.7MB → 4.9MB（群にまとめると 1.2MB）。ファイルは 1 行 1 体になり、検索や差分が見やすくなりました。"
          "★このバージョンで保存したシーンは 2.0.x 以前のエンジンでは正しく開けません。インスタンス群を使ったシーンは隣の .inst フォルダも一緒に配ってください。",
          "perf" },
        { "配布ゲームの初回起動が速くなりました",
          "テクスチャの変換をビルド時に済ませるので、初めて起動しても待たされません。",
          "大きなプロジェクトで初回 79 秒 → 3 秒。その分、初回のビルドは 1〜2 分長くなり、ゲームのデータ（pak）は大きくなります。",
          "general" },
        { "物理の不具合をまとめて直しました",
          "当たり判定のずれ・すり抜け・大量に積むと床を抜ける・質量 0 で落ちる、など 20 件以上。",
          "当たり判定の offset が回転と拡大縮小に従うようになりました（動く壁や扉の判定が見た目と合います）。"
          "新しく追加する剛体だけ、摩擦 0.6・反発 0.1・高速移動のすり抜け防止（CCD）が既定で有効です。既存のシーンの値は変わりません。",
          "physics" },
        { "シーンの一部が消えて保存される事故を直しました",
          "モデルが見つからない物体を捨てなくなりました。読み込み中に Play しても前のシーンを壊しません。",
          "これまではモデルのファイルを移動・改名しただけで、次の保存でその物体がシーンから消えていました。今は描画せずに残し、モデルが戻れば元どおり表示されます。",
          "editor" },
    },
    {
        { K::Feature, "インスタンス群", "ヒエラルキーの右クリックで「まとめる / 展開」。MCP は instance_group。描画・影・当たり判定・ナビ・GI はそのまま動きます" },
        { K::Feature, "Lua の raycast が当たった相手を返す", "hit.entity" },
        { K::Improvement, "シーンの読み込み", "同じモデルを大量に置いたシーンで約 10〜14 倍速く" },
        { K::Improvement, "プレハブにインスタンス群を入れられる", "" },
        { K::Improvement, "物理の上限", "物体数・接触数の上限を引き上げ、超えたときは知らせます（get_physics_state）" },
        { K::Fix, "配布ゲームでテクスチャが欠ける", "\"../\" を含むパスで参照しているテクスチャが読めず、白くなっていました" },
        { K::Fix, "配布ゲームが暗号化していないテクスチャを書き出す", "実行時のキャッシュも暗号化して保存します" },
        { K::Fix, "地形のあるシーンで配布ゲームが起動直後に落ちる", "" },
        { K::Fix, "プロジェクトを開いた直後の Play で、前のプロジェクトのシーンが欠けて上書きされる", "" },
        { K::Fix, "キャラ同士がすり抜ける・レイや重なり判定にキャラが出ない", "" },
        { K::Fix, "Play 中に静的な物体を動かしても当たり判定が付いてこない", "" },
        { K::Fix, "フレームレートが低いと物体が遅く動く", "1 フレームが長いときに物理の時間が切り捨てられていました" },
    },
});

v.push_back(Release{
    "2.0.1", "2026-10-01",
    "グリッドのちらつきと途切れを直しました",
    {
        { "グリッドが正しく描かれるようになりました",
          "床やモデルと重なった部分のちらつきと、見る向きによって手前の線が途中で消える不具合を直しました。",
          "グリッドの奥行きを、巨大な板の補間ではなく、視線と床の交点からピクセルごとに正確に求めるようにしました。"
          "床から少し浮いた物の上には線が乗りません。正射投影（2D 表示・正射カメラ）でも正しく描かれます。",
          "editor" },
    },
    {
        { K::Fix, "更新の案内とダウンロード中は起動音を鳴らさない", "これまでは待っている間も起動音が繰り返し鳴っていました" },
        { K::Feature, "更新の流れの見本", "DX12Engine.exe --demo-update で、更新の案内からダウンロード・適用までを実際には更新せずに確認できます（=error で失敗時の画面）" },
    },
});

v.push_back(Release{
    "2.0.0", "2026-10-01",
    "光が正しく回るようになり、エディタも一新しました",
    {
        { "新しい GI（間接光）",
          "屋内が窓と灯りに見合った明るさになり、色付きの壁の照り返しや、光る看板が周りを照らす様子が出ます。",
          "金属や床は室内で空を映さなくなりました。正解の絵（パストレーサー）との差は、約 16 倍の明るすぎから ±0.5EV 以内へ。重さは 1.0ms。"
          "新しく作るシーンは自動で有効です。既存のシーンはライティング窓の「新しい GI に切り替える」で移行します（見た目は勝手に変わりません）。",
          "lighting" },
        { "エディタの見た目と操作性を一新",
          "新しいテーマ・アイコン・フォント。表示倍率に合わせたくっきりした表示、コマンドパレット、通知。",
          "プロジェクトを選ぶランチャーと起動画面も作り直しました。",
          "editor" },
        { "物理が安定しました",
          "動く物体のがくつき（144fps で 6 割のフレームが止まって見えていた）を解消。キャラが箱に乗っても箱が飛びません。",
          "",
          "physics" },
        { "新しい表現（試験的）",
          "物理ベースの空と時刻、水面、草木の大量配置と風、ノードで組むマテリアル。",
          "空と時刻は朝焼け・夕焼け・夜、水面は波・屈折・泡・水中に対応します。マテリアルグラフはノードエディタで組みます。",
          "world" },
    },
    {
        { K::Feature, "パストレーサー", "光の計算の「正解」の絵を描く参照レンダラ（MCP dx12_render_reference）。見た目の確認や比較に使えます" },
        { K::Feature, "物理ベースの大気と時刻", "シーン設定から。既定は従来の空です" },
        { K::Feature, "水面（WaterBody）", "" },
        { K::Feature, "植生レイヤー", "大量の草木を 1 つのコンポーネントで配置でき、風で揺れます" },
        { K::Feature, "マテリアルグラフ", "ノードエディタ。試験的" },
        { K::Feature, "オーディオミキサー窓", "バス・メーター・スナップショット。リバーブ域、OGG のストリーミング再生とループ点、同時発音数の優先度も追加" },
        { K::Feature, "ゲーム AI（Brain コンポーネント）", "知覚、判断、Lua の行動。群衆の回避とディレクターのひな型も追加" },
        { K::Feature, "セーブスロット", "Lua の save.*。入れ子のテーブルとエンティティの状態を保存できます" },
        { K::Feature, "光の物理単位と露出", "lux / cd と EV の露出、UE 風トーンマッパ（選択式。既定は従来どおり）" },
        { K::Feature, "仮想ジオメトリ", "超高ポリゴン向け。試験的・既定 OFF" },

        { K::Improvement, "起動画面", "実際の読み込み進捗をリングで表示" },
        { K::Improvement, "表示倍率（DPI）対応", "全画面を表示倍率に合わせてくっきり表示" },
        { K::Improvement, "撮影", "任意の解像度、線形の PFM / EXR で保存" },
        { K::Improvement, "MCP（AI から操作する口）", "エージェントごとの専用エンジン、長い処理のジョブ化、分かりやすいエラーと直し方の提示、Undo / トランザクション、品質ゲート" },
        { K::Improvement, "DDGI", "カメラに追従し（範囲を手で合わせなくてよい）、灯りの多い場所でも重くなりません" },

        { K::Fix, "動く物体に乗ると吹き飛ぶ", "キャラが動く物体に乗ると、物体が吹き飛ぶ・揺れ続けることがありました" },
        { K::Fix, "動く物体のがくつき", "画面のフレームレートによって、動く物体ががくついて見えました" },
        { K::Fix, "レイトレの AO で金属の球が真っ黒", "球の法線が内向きだったのが原因です" },
        { K::Fix, "DDGI 有効のままシーンを切り替えると GPU が応答しない", "" },
        { K::Fix, "ウィンドウの大きさを変えると DDGI の明るさが一瞬落ちる", "" },
        { K::Fix, "裏で起動しても起動画面が手前に出る", "自動テストなどでエンジンを裏で起動したときの問題です" },
        { K::Fix, "描画の順番が起動ごとに変わる", "" },
        { K::Fix, "ナビメッシュ API の欠陥", "いくつかの欠陥を修正" },
    }
});

v.push_back(Release{
    "1.19.0", "2026-09-30",
    "ステージを丸ごと取り込んで歩けるようにしました",
    {
        { "メッシュそのままの当たり判定",
          "部屋の殻・廊下・階段のような中が空洞の形でも歩けます。同じモデルは当たり判定の準備を共有します。",
          "これまでの凸包では中身が詰まって歩けませんでした。形はモデル単位で使い回し、拡大縮小は後から掛けるので、"
          "同じモデルを数千個置いても準備は 1 回です（実測: 1 ステージ 13,522 個で 3,387 通りの大きさ）。",
          "physics" },
        { "当たり判定が 4096 個で止まる不具合を修正",
          "上限を 65536 に引き上げ、作れなかったときは必ずログに出します。",
          "物理エンジンの上限に達すると警告なく捨てられ、「一部の床だけすり抜ける」「再生した瞬間に落ち続ける」という形でしか気付けませんでした。",
          "physics" },
        { "自己発光マテリアル",
          "天井の照明パネルや看板のように、それ自体が光って見える面を作れます。ブルームと組み合わせると光がにじみます。",
          "色と強さをインスペクターから指定でき、テクスチャで光る形も描けます（強さは 0〜64）。自己発光を指定していないモデルの見た目は 1 ピクセルも変わりません。",
          "render" },
        { "静止シーンで動的 GI が速くなりました",
          "シーンの中身が前のフレームと同じなら、レイトレの下準備を省きます。実測 53.6 → 115.0 fps。",
          "動的 GI（DDGI）を有効にすると、2 万個の物体ぶんの下準備を毎フレーム作り直し、それだけで 1 フレーム 11.5 ミリ秒かかっていました。"
          "絵はピクセル単位で完全に同じです。物が動いた・増えた・減った、キャラが居る、といったときは今までどおり作り直します。",
          "perf" },
    },
    {
        { K::Feature, "メッシュそのままの当たり判定（Mesh Collider）", "三角形メッシュをそのまま当たり判定にできます。部屋の殻・廊下・階段など中が空洞の形向け" },
        { K::Feature, "自己発光マテリアル（Emissive）", "色と強さをインスペクターから指定。ブルームと組み合わせると光がにじみます" },
        { K::Feature, "スクリプトからキャラを任意の場所へ移動", "physics:warp(entity, x, y, z)。穴に落ちたら開始地点へ戻す、といった処理が書けます" },

        { K::Improvement, "静止しているシーンでレイトレの下準備を省略", "動的 GI（DDGI）有効時に 53.6 → 115.0 fps。絵は完全に同じです" },

        { K::Fix, "当たり判定が 4096 個までしか作られていなかった", "上限を 65536 まで引き上げ、作れなかったときはログに出します" },
        { K::Fix, "露出がブルーム / ゴッドレイ / レンズフレアに掛かっていなかった", "自動露出が使えない原因でした" },
        { K::Fix, "レイトレ影で葉・柵・金網の影が矩形になっていた", "" },
        { K::Fix, "キャラクター（スキンドメッシュ）にだけ動的 GI が乗っていなかった", "" },
        { K::Fix, "オクルージョン判定のバッファを GPU が使っている最中に解放していた", "" },
        { K::Fix, "配布したゲームが環境によって起動しないことがあった", "" },
        { K::Fix, "入力欄で打った文字が、後からショートカットとして発火することがあった", "" },
        { K::Fix, "ゲーム内 UI を一度押すとパッド操作が効かなくなっていた", "" },
    }
});
